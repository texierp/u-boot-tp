## fitImage.its
```
/dts-v1/;

/ {
	description = "fitImage ynov";
	#address-cells = <1>;

	images {
		kernel {
			description = "zImage";
			data = /incbin/("./zImage");
			type = "kernel";
			arch = "arm";
			os = "linux";
			compression = "none";
			load = <0x80800000>;
			entry = <0x80800000>;
			hash-1 {
				algo = "sha256";
			};
		};
		fdt-1 {
			description = "Flattened Device Tree blob";
			data = /incbin/("./imx7s-warp.dtb");
			type = "flat_dt";
			arch = "arm";
			compression = "none";
			hash-1 {
				algo = "sha256";
			};
		};
	};

	configurations {
		default = "conf-1";
		conf-1 {
			description = "Ynov Embedded Linux Configuration";
			kernel = "kernel";
			fdt = "fdt-1";
			signature {
				algo = "sha256,rsa4096";
				key-name-hint = "ynov";
				sign-images = "fdt", "kernel";
			};
		};
	};
};
```
